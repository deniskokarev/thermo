## firm/boards/arm/nrf52832_hello/Kconfig.board
```kconfig
# nRF52 DK NRF52832 board configuration

# Copyright (c) 2016 Nordic Semiconductor ASA
# SPDX-License-Identifier: Apache-2.0

config BOARD_NRF52832_HELLO
	bool "NRF52832 Hello Board"
	depends on SOC_NRF52832_QFAA
```

## firm/boards/arm/nrf52832_hello/nrf52832_hello_defconfig
```kconfig
# SPDX-License-Identifier: Apache-2.0

CONFIG_BOARD_NRF52832_HELLO=y

# our hello schematic has no external 32kHz clock
CONFIG_CLOCK_CONTROL_NRF_K32SRC_RC=y

CONFIG_SOC_SERIES_NRF52X=y
CONFIG_SOC_NRF52832_QFAA=y

# Enable MPU
CONFIG_ARM_MPU=y

# Enable hardware stack protection
CONFIG_HW_STACK_PROTECTION=y

# Enable RTT if needed to be used with CONFIG_RTT_CONSOLE
# CONFIG_USE_SEGGER_RTT=y

# enable GPIO
CONFIG_GPIO=y

# enable uart driver
CONFIG_SERIAL=y

# enable console
CONFIG_CONSOLE=y
CONFIG_UART_CONSOLE=y

# additional board options
CONFIG_GPIO_AS_PINRESET=y

CONFIG_PINCTRL=y

# for some reason DCDC doesn't want to work properly :-(
# when enabled works only if started from debugger, wtf???
# otherwise program hangs at *** Booting Zephyr OS...
# disabling for now
CONFIG_BOARD_ENABLE_DCDC=n
```

## firm/boards/arm/nrf52832_therm/nrf52832_therm_defconfig
```kconfig
# SPDX-License-Identifier: Apache-2.0

CONFIG_BOARD_NRF52832_THERM=y

# our hello schematic has no external 32kHz clock
CONFIG_CLOCK_CONTROL_NRF_K32SRC_RC=y

# Enable MPU
CONFIG_ARM_MPU=y

# Enable hardware stack protection
CONFIG_HW_STACK_PROTECTION=y

# enable GPIO
CONFIG_GPIO=y

# Use RTT console
CONFIG_CONSOLE=y
CONFIG_RTT_CONSOLE=y
CONFIG_USE_SEGGER_RTT=y
CONFIG_UART_CONSOLE=n

CONFIG_PINCTRL=y
```

## firm/boards/shields/thermo/Kconfig.shield
```kconfig
# Copyright (c) 2019 Linaro Limited
# SPDX-License-Identifier: Apache-2.0

config SHIELD_THERMO
	def_bool $(shields_list_contains,thermo)
```

## firm/test/testcase.yaml
```yaml
tests:
  thermo.test:
    platform_allow:
      - native_posix
      - native_sim
      - qemu_x86
```
